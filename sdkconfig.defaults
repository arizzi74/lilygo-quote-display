## sdkconfig.defaults
```kconfig
# PSRAM Configuration (CRITICAL - required for framebuffer)
CONFIG_ESP32_SPIRAM_SUPPORT=y
CONFIG_SPIRAM_USE_MALLOC=y
CONFIG_SPIRAM_MALLOC_ALWAYSINTERNAL=16384
CONFIG_SPIRAM_MALLOC_RESERVE_INTERNAL=32768

# PSRAM mode for classic ESP32 (use QUAD mode)
CONFIG_SPIRAM_MODE_QUAD=y
CONFIG_SPIRAM_TYPE_AUTO=y
CONFIG_SPIRAM_SIZE=8388608

# Allow stack in external memory
CONFIG_SPIRAM_ALLOW_STACK_EXTERNAL_MEMORY=y

# Flash size: 16MB
CONFIG_ESPTOOLPY_FLASHSIZE_16MB=y
CONFIG_ESPTOOLPY_FLASHSIZE="16MB"

# Flash mode
CONFIG_ESPTOOLPY_FLASHMODE_QIO=y
CONFIG_ESPTOOLPY_FLASHFREQ_80M=y

# Partition table
CONFIG_PARTITION_TABLE_CUSTOM=y
CONFIG_PARTITION_TABLE_CUSTOM_FILENAME="partitions.csv"
CONFIG_PARTITION_TABLE_FILENAME="partitions.csv"

# ESP32 CPU frequency
CONFIG_ESP32_DEFAULT_CPU_FREQ_240=y

# Compiler optimization
CONFIG_COMPILER_OPTIMIZATION_SIZE=y

# Enable FreeRTOS task watchdog
CONFIG_ESP_TASK_WDT=y
CONFIG_ESP_TASK_WDT_TIMEOUT_S=10

# Log level
CONFIG_LOG_DEFAULT_LEVEL_INFO=y

# Reduce WiFi log verbosity to suppress beacon timeout warnings
CONFIG_LOG_MAXIMUM_LEVEL_INFO=y
CONFIG_BOOTLOADER_LOG_LEVEL_INFO=y

# Enable MBEDTLS certificate bundle for HTTPS
CONFIG_MBEDTLS_CERTIFICATE_BUNDLE=y
CONFIG_MBEDTLS_CERTIFICATE_BUNDLE_DEFAULT_FULL=y
```
